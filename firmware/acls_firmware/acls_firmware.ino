// ACLS shared firmware template, topic schema v1.
// Never hand-edit this file: every per-device value (pins, trigger level, device ID, credentials)
// lives in config.h, generated by the ACLS website (Devices > device > "Generate config.h").
//
// Behaviour taken from the verified sketches (PRD Appendix A1-A3):
//   boot-safe relay init (OFF before and after pinMode), WiFi restart after 20 s, MQTT reconnect
//   loop with 5 s retry, Last Will "offline", retained state after every change and on reconnect,
//   all relays OFF after power loss (the server restores the saved state once the board is online).
// New, per the PRD: per-device topics + JSON, username/secret auth, command ack, telemetry every 60 s.
// 1.1.0: update over WiFi from the website ({"ota":"<url>"} command, owner request 2026-10-21).
//        Nothing else changed; after the update the board reboots, relays boot OFF and the server restores them.
// 1.1.1: ESP32 device ID read from the chip (esp_read_mac) instead of WiFi.macAddress(), which returns
//        00:00:00:00:00:00 before WiFi has started on ESP32 core 3.x (found on a real board 2026-10-22).
// 1.2.0: cloud deployment (owner request 2026-10-22): encrypted MQTT (TLS) to an external broker such as
//        HiveMQ Cloud when config.h defines MQTT_TLS, with the clock set by NTP to check its certificate;
//        reports its build (ACLS_BUILD) in telemetry; WiFi updates also from https:// addresses. The MQTT
//        connection is closed during an update so an ESP8266 has the memory for the download.
//
// Board: ESP32 Dev Module or NodeMCU 1.0 (ESP-12E Module). Upload speed 115200.
// Libraries: PubSubClient (Nick O'Leary), ArduinoJson 7.x.

#define ACLS_FW_VERSION "1.2.0"  // template version, shown on the website; bump when this file changes

#include "config.h"

#ifndef ACLS_BUILD
#define ACLS_BUILD ""  // config.h from before 1.2.0
#endif

#if defined(ACLS_BOARD_ESP8266) && !defined(ESP8266)
#error "This config.h is for a NodeMCU. Select Tools > Board > NodeMCU 1.0 (ESP-12E Module)."
#endif
#if defined(ACLS_BOARD_ESP32) && !defined(ESP32)
#error "This config.h is for an ESP32 DevKit. Select Tools > Board > ESP32 Dev Module."
#endif

#ifdef ESP8266
#include <ESP8266WiFi.h>
#include <ESP8266httpUpdate.h>
#else
#include <WiFi.h>
#include <WiFiClientSecure.h>
#include <HTTPUpdate.h>
#include <esp_system.h>
#include <esp_mac.h>
#endif
#include <PubSubClient.h>
#include <ArduinoJson.h>
#include <time.h>

static const uint8_t RELAY_PINS[RELAY_COUNT] = RELAY_PIN_LIST;
static uint8_t relayState[RELAY_COUNT];  // 1 = ON, 0 = OFF

#ifdef MQTT_TLS
#ifdef ESP8266
BearSSL::WiFiClientSecure netClient;
#else
WiFiClientSecure netClient;
#endif
#else
WiFiClient netClient;
#endif
PubSubClient mqtt(netClient);

char deviceId[16];
char topicCmd[64], topicState[64], topicStatus[64], topicTelemetry[64], topicOta[64];
unsigned long lastTelemetry = 0;

// Update over WiFi: requested from the MQTT callback, carried out from loop().
bool otaRequested = false;
char otaUrl[200];
char otaId[24];
bool otaFailed = false;  // reported once MQTT is connected again
char otaError[100];

// ---- Status LED: blink = connecting, solid = connected ----

void led(bool on) {
#if STATUS_LED_PIN >= 0
  digitalWrite(STATUS_LED_PIN, on ? STATUS_LED_ON : (STATUS_LED_ON == LOW ? HIGH : LOW));
#endif
}

// ---- Relays ----

void initRelays() {
  for (int i = 0; i < RELAY_COUNT; i++) {
    digitalWrite(RELAY_PINS[i], RELAY_OFF);  // OFF level first so the relay never clicks ON at boot
    pinMode(RELAY_PINS[i], OUTPUT);
    digitalWrite(RELAY_PINS[i], RELAY_OFF);
    relayState[i] = 0;
  }
}

void setRelay(int index, bool on) {
  relayState[index] = on ? 1 : 0;
  digitalWrite(RELAY_PINS[index], on ? RELAY_ON : RELAY_OFF);
}

// ---- Device ID: "acls-" + last 3 bytes of the WiFi MAC (= ESP.getChipId() on ESP8266) ----

void makeDeviceId() {
  uint8_t mac[6];
#ifdef ESP8266
  WiFi.macAddress(mac);
#else
  esp_read_mac(mac, ESP_MAC_WIFI_STA);  // from the chip's eFuse: valid even before WiFi starts
#endif
  snprintf(deviceId, sizeof(deviceId), "acls-%02x%02x%02x", mac[3], mac[4], mac[5]);
}

// ---- MQTT payloads ----

void publishState(const char* ack) {
  JsonDocument doc;
  JsonArray ch = doc["ch"].to<JsonArray>();
  for (int i = 0; i < RELAY_COUNT; i++) ch.add(relayState[i]);
  if (ack && ack[0]) doc["ack"] = ack;
  char buf[128];
  size_t n = serializeJson(doc, buf, sizeof(buf));
  mqtt.publish(topicState, (const uint8_t*)buf, n, true);  // retained
}

const char* resetReason() {
#ifdef ESP8266
  switch (ESP.getResetInfoPtr()->reason) {
    case REASON_DEFAULT_RST: return "power";
    case REASON_WDT_RST:
    case REASON_SOFT_WDT_RST: return "watchdog";
    case REASON_EXCEPTION_RST: return "exception";
    case REASON_SOFT_RESTART: return "software";
    case REASON_DEEP_SLEEP_AWAKE: return "deepsleep";
    case REASON_EXT_SYS_RST: return "external";
    default: return "other";
  }
#else
  switch (esp_reset_reason()) {
    case ESP_RST_POWERON: return "power";
    case ESP_RST_BROWNOUT: return "brownout";
    case ESP_RST_INT_WDT:
    case ESP_RST_TASK_WDT:
    case ESP_RST_WDT: return "watchdog";
    case ESP_RST_PANIC: return "exception";
    case ESP_RST_SW: return "software";
    case ESP_RST_DEEPSLEEP: return "deepsleep";
    case ESP_RST_EXT: return "external";
    default: return "other";
  }
#endif
}

void publishTelemetry() {
  JsonDocument doc;
  doc["rssi"] = WiFi.RSSI();
  doc["uptime"] = millis() / 1000;
  doc["heap"] = ESP.getFreeHeap();
  doc["fw"] = ACLS_FW_VERSION;
  doc["reset"] = resetReason();
  if (ACLS_BUILD[0]) doc["build"] = ACLS_BUILD;
  char buf[220];
  size_t n = serializeJson(doc, buf, sizeof(buf));
  mqtt.publish(topicTelemetry, (const uint8_t*)buf, n, false);
}

void publishOta(const char* id, const char* result, const char* error) {
  JsonDocument doc;
  doc["id"] = id;
  doc["result"] = result;
  if (error && error[0]) doc["error"] = error;
  char buf[200];
  size_t n = serializeJson(doc, buf, sizeof(buf));
  mqtt.publish(topicOta, (const uint8_t*)buf, n, false);
}

// Downloads the new firmware from the ACLS server and reboots into it. The updater checks the file
// against the MD5 the server sends (x-MD5), so a broken download is never installed.
// Only returns if the update failed.
template <typename Client>
void downloadUpdate(Client& client) {
#ifdef ESP8266
  ESPhttpUpdate.rebootOnUpdate(true);
  t_httpUpdate_return r = ESPhttpUpdate.update(client, otaUrl);
  String err = ESPhttpUpdate.getLastErrorString();
#else
  httpUpdate.rebootOnUpdate(true);
  t_httpUpdate_return r = httpUpdate.update(client, otaUrl);
  String err = httpUpdate.getLastErrorString();
#endif
  Serial.printf("OTA: failed (%d) %s\n", (int)r, err.c_str());
  strlcpy(otaError, err.c_str(), sizeof(otaError));
  otaFailed = true;
}

void runOta() {
  otaRequested = false;
  Serial.printf("OTA: downloading %s\n", otaUrl);
  publishOta(otaId, "started", "");
  mqtt.loop();
  delay(200);
  mqtt.disconnect();  // frees the encrypted connection's memory for the download; reconnects after
  if (strncmp(otaUrl, "https://", 8) == 0) {
#ifdef ESP8266
    BearSSL::WiFiClientSecure client;
#else
    WiFiClientSecure client;
#endif
    client.setInsecure();  // encrypted; the MD5 check above guards the file itself
    downloadUpdate(client);
  } else {
    WiFiClient client;
    downloadUpdate(client);
  }
}

// {"id":"<cmdId>","ch":1,"state":"ON"}, {"id":"<cmdId>","all":"OFF"} or {"id":"<cmdId>","ota":"<url>"}
void onMessage(char* topic, byte* data, unsigned int length) {
  if (strcmp(topic, topicCmd) != 0) return;
  JsonDocument doc;
  if (deserializeJson(doc, (const char*)data, length)) {
    Serial.println("cmd: bad JSON, ignored");
    return;
  }
  char ack[24];
  strlcpy(ack, doc["id"] | "", sizeof(ack));

  const char* ota = doc["ota"] | "";
  if (ota[0]) {
    strlcpy(otaUrl, ota, sizeof(otaUrl));
    strlcpy(otaId, ack, sizeof(otaId));
    otaRequested = true;
    return;
  }

  const char* all = doc["all"] | "";
  if (strcmp(all, "ON") == 0 || strcmp(all, "OFF") == 0) {
    bool on = strcmp(all, "ON") == 0;
    for (int i = 0; i < RELAY_COUNT; i++) setRelay(i, on);
    Serial.printf("cmd %s: all %s\n", ack, all);
  } else {
    int ch = doc["ch"] | 0;
    const char* state = doc["state"] | "";
    bool on = strcmp(state, "ON") == 0;
    if (ch < 1 || ch > RELAY_COUNT || (!on && strcmp(state, "OFF") != 0)) {
      Serial.println("cmd: ignored (bad channel or state)");
      return;
    }
    setRelay(ch - 1, on);
    Serial.printf("cmd %s: IN%d %s\n", ack, ch, state);
  }
  publishState(ack);
}

// ---- Connections ----

// Encrypted MQTT: check the broker's certificate (needs the real time, from NTP) or, without a root
// certificate in config.h, encrypt only.
void setupTls() {
#ifdef MQTT_TLS
#ifdef MQTT_HAS_CA
  configTime(0, 0, "pool.ntp.org", "time.google.com");
  Serial.print("Clock: syncing");
  for (int i = 0; i < 30 && time(nullptr) < 1700000000; i++) {
    delay(500);
    Serial.print('.');
  }
  Serial.println(time(nullptr) < 1700000000 ? " failed (certificate check will fail)" : " done");
#ifdef ESP8266
  static BearSSL::X509List trusted(MQTT_CA_CERT);
  netClient.setTrustAnchors(&trusted);
#else
  netClient.setCACert(MQTT_CA_CERT);
#endif
#else
  netClient.setInsecure();
#endif
#ifdef ESP8266
  // Smaller TLS buffers when the broker allows it: more free memory for everything else
  if (netClient.probeMaxFragmentLength(MQTT_HOST, MQTT_PORT, 1024)) netClient.setBufferSizes(1024, 1024);
#endif
#endif
}

void connectWiFi() {
  WiFi.mode(WIFI_STA);
  WiFi.begin(WIFI_SSID, WIFI_PASSWORD);
  Serial.printf("WiFi: connecting to \"%s\"", WIFI_SSID);
  int tries = 0;
  while (WiFi.status() != WL_CONNECTED) {
    led(tries % 2 == 0);
    delay(500);
    Serial.print('.');
    if (++tries > 40) {  // 20 s
      Serial.println("\nWiFi: not connected after 20 s, restarting");
      ESP.restart();
    }
  }
  Serial.printf("\nWiFi: connected, IP %s, RSSI %d dBm\n", WiFi.localIP().toString().c_str(), WiFi.RSSI());
}

void connectMQTT() {
  while (!mqtt.connected()) {
    if (WiFi.status() != WL_CONNECTED) connectWiFi();
#ifdef MQTT_TLS
    Serial.printf("MQTT: connecting to %s:%d (TLS) as %s\n", MQTT_HOST, MQTT_PORT, deviceId);
#else
    Serial.printf("MQTT: connecting to %s:%d as %s\n", MQTT_HOST, MQTT_PORT, deviceId);
#endif
    // Last Will: the broker announces "offline" (retained) if this board disappears.
    if (mqtt.connect(deviceId, MQTT_USER, MQTT_PASSWORD, topicStatus, 0, true, "offline")) {
      mqtt.publish(topicStatus, "online", true);
      mqtt.subscribe(topicCmd);
      publishState(nullptr);
      publishTelemetry();
      lastTelemetry = millis();
      if (otaFailed) {
        publishOta(otaId, "failed", otaError);
        otaFailed = false;
      }
      led(true);
      Serial.println("MQTT: connected, waiting for commands");
    } else {
      int st = mqtt.state();
      Serial.printf("MQTT: failed (state %d)%s, retry in 5 s\n", st,
                    st == 4 || st == 5 ? ": wrong credentials, regenerate config.h on the website" : "");
      for (int i = 0; i < 10; i++) {
        led(i % 2 == 0);
        delay(500);
      }
    }
  }
}

void setup() {
  initRelays();  // before anything else
#if STATUS_LED_PIN >= 0
  pinMode(STATUS_LED_PIN, OUTPUT);
  led(false);
#endif
  Serial.begin(115200);
  delay(50);
  Serial.printf("\n\nACLS firmware %s, profile %s, %d relay channel(s)\n", ACLS_FW_VERSION, ACLS_PROFILE, RELAY_COUNT);

  WiFi.mode(WIFI_STA);
  makeDeviceId();
  Serial.printf("Device ID: %s (chip ID %s)\n", deviceId, deviceId + 5);
  if (strcmp(deviceId, DEVICE_ID) != 0) {
    // config.h was generated for a different board: never control the wrong room.
    Serial.printf("ERROR: config.h is for %s but this board is %s. Register this board and regenerate config.h.\n",
                  DEVICE_ID, deviceId);
    while (true) {
      led(true);
      delay(100);
      led(false);
      delay(100);
    }
  }

  snprintf(topicCmd, sizeof(topicCmd), "%s/%s/cmd", TOPIC_ROOT, deviceId);
  snprintf(topicState, sizeof(topicState), "%s/%s/state", TOPIC_ROOT, deviceId);
  snprintf(topicStatus, sizeof(topicStatus), "%s/%s/status", TOPIC_ROOT, deviceId);
  snprintf(topicTelemetry, sizeof(topicTelemetry), "%s/%s/telemetry", TOPIC_ROOT, deviceId);
  snprintf(topicOta, sizeof(topicOta), "%s/%s/ota", TOPIC_ROOT, deviceId);

  connectWiFi();
  setupTls();
  mqtt.setServer(MQTT_HOST, MQTT_PORT);
  mqtt.setCallback(onMessage);
  mqtt.setKeepAlive(15);  // broker marks the board offline ~23 s after it goes silent
  mqtt.setBufferSize(512);
}

void loop() {
  if (WiFi.status() != WL_CONNECTED) connectWiFi();
  if (!mqtt.connected()) connectMQTT();
  mqtt.loop();
  if (otaRequested) runOta();
  if (millis() - lastTelemetry >= 60000UL) {
    lastTelemetry = millis();
    publishTelemetry();
  }
}
